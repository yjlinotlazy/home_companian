## clients/crowpanel/crowpanel-579/main/Kconfig.projbuild
```kconfig
menu "CrowPanel network configuration"

    config CROWPANEL_WIFI_SSID
        string "Wi-Fi SSID"
        default ""

    config CROWPANEL_WIFI_PASSWORD
        string "Wi-Fi password"
        default ""

    config CROWPANEL_WIFI_MAXIMUM_RETRY
        int "Maximum connection retries"
        range 1 100
        default 10

    config CROWPANEL_SERVER_URL
        string "Device-specific framebuffer URL"
        default ""
        help
            Full device endpoint ending in /next, for example:
            https://<local-ip>:8003/v1/devices/wall_panel/next

endmenu
```
